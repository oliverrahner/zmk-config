## config/west.yml
```yaml
manifest:
  defaults:
    revision: v0.3
  remotes:
    - name: aerobreaker
      url-base: https://github.com/Aerobreaker
    # Additional modules containing boards/shields/custom code can be listed here as well
    # See https://docs.zephyrproject.org/3.2.0/develop/west/manifest.html#projects
  projects:
    - name: zmk
      remote: aerobreaker
      repo-path: glove80-zmk
      revision: main
      import: app/west.yml
  self:
    path: config
```
